## 1781544180633-akdk/boards/shields/1781544180633/Kconfig.defconfig
```kconfig
if SHIELD_1781544180633_RIGHT

config ZMK_KEYBOARD_NAME
    default "1781544180633"

endif

if SHIELD_1781544180633_LEFT || SHIELD_1781544180633_RIGHT

config ZMK_SPLIT
    default y

endif
```

## 1781544180633-akdk/boards/shields/1781544180633/Kconfig.shield
```kconfig
config SHIELD_1781544180633_LEFT
    def_bool $(shields_list_contains,1781544180633_left)
config SHIELD_1781544180633_RIGHT
    def_bool $(shields_list_contains,1781544180633_right)
```
